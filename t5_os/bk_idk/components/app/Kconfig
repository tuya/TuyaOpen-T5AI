## t5_os/bk_idk/middleware/driver/h264/Kconfig
```kconfig
menu "H264_CONFIG"
	config H264
		bool "Enable h264"
		default n

	config H264_QUALITY_LEVEL
		int "set h264 compress quality level"
		range 0 3
		default 2

	config H264_GOP_START_IDR_FRAME
		bool "Enable add pps and sps before i frame"
		default y

	config H264_ADD_SELF_DEFINE_SEI
		depends on H264
		bool "Enable function add sei nalu for self define, contain frame information"
		default y

	config H264_P_FRAME_CNT
		int "config h264 encode one I frame then output H264_P_FRAME_CNT p frame"
		range 0 1023
		default 5
endmenu
```

## t5_os/bk_idk/middleware/driver/jpeg_dec/Kconfig
```kconfig
menu "JPEG_DEC"
	config JPEGDEC_HW
		bool "Enable JPEGDEC Display"
		default n
		
	config JPEGDEC_HW_SUPPORT_DRI
		bool "Enable JPEGDEC support dri"
		default n
	config JPEGDEC_HW_SUPPORT_FFD9_CHECK
		bool "Enable JPEGDEC ff d9 check"
		default n
endmenu
```

## t5_os/bk_idk/middleware/driver/lin/Kconfig
```kconfig
menu "LIN"
	config LIN
		bool "Enable LIN"
		default n
	config LIN_DEVICE_MASTER
		bool "This device is the master"
		default n
		depends on LIN
	config LIN_PM_CB_SUPPORT
		bool "This device is the master"
		default n
		depends on LIN
endmenu
```

## t5_os/bk_idk/middleware/driver/mailbox/Kconfig
```kconfig
menu "MAILBOX"
	config MAILBOX
		bool "Enable mail_box"
		default n

	config MAILBOX_V2_0
		bool "Use mailbox v2.0 driver"
		default n
endmenu
```

## t5_os/bk_idk/middleware/driver/otp/Kconfig
```kconfig
menu "OTP"
	config OTP
		bool "Enable OTP"
		default n

	config OTP_V1
		bool "Enable OTP_V1"
		default n

	config PHY_RFCALI_TO_OTP
		bool "Enable rfcali_to_otp"
		default n
		help
			Use OTP to save rfcali data

	config OTP_SLEEP
		bool "Enable OTP sleep"
		default n
endmenu
```

## t5_os/bk_idk/middleware/driver/pwm/Kconfig
```kconfig
menu "PWM"
	config PWM
		bool "Enable pwm"
		default y

	choice PWM_VERSION
		prompt "ASIC PWM IP Version"
		default PWM_V0P0

		config PWM_V0P0
			bool "PWM_V0P0"
			help
			    ASIC PWM IP Version V0P0:BK7256XX,BK7251XX,the chips MP before 2023-04

		config PWM_V1PX
			bool "PWM_V1PX"
			help
			    "ASIC PWM IP Version V1P1:BK7236XX...,the chips MP after 2023-04"
	endchoice

	config PWM_HAS_TWO_INT
		bool "Enable pwm has two int"
		default n

	config PWM_PM_CB_SUPPORT
		bool "PWM PM Support"
		default n

	config PWM_PHASE_SHIFT
		bool "PWM phase shift Support"
		default n

endmenu
```

## t5_os/bk_idk/middleware/driver/pwr_clk/Kconfig
```kconfig
menu "PWR_CLK"
	config EXTERN_32K
		bool "Use an external 32k crystal"
		default n
	config MEM_AUTO_POWER_DISABLE
		bool "mem auto power disable"
		default n
	config CP1_AUTO_POWER_DISABLE
		bool "cp1 auto power disable"
		default n
	config CPU_DEFAULT_FREQ_60M
		bool "set cpu default frequency 60M"
		default n
	config RESERVE_1K_SRAM_UNINITIAL
		bool "reserve 1k sram uninitialized"
		default n
	config LPO_SRC_26M32K
		bool "32k use the 26m divide"
		default n
	config BUCK_ENABLE
		bool "buck enable"
		default n
	config BAKP_POWER_DOMAIN_DISABLE
		 bool "bakp power domain disable"
		default n
	config BAKP_POWER_DOMAIN_PM_CONTROL
		 bool "used for PM control of bakp domain power on and off"
		default n
	config AHBP_POWER_DOMAIN_LV_DISABLE
		 bool "ahbp power domain disable"
		default n
	config PSRAM_POWER_DOMAIN_LV_DISABLE
		 bool "psram power domain disable"
		default n
	config DCO_CLK_ENABLE
		bool "Enable dco clk"
		default n
	config EXTERN_32K_PIN_MULT
		 bool "extern32k pin multiplexing"
		default n
	config VBSPBUFLP1V_ENABLE
		 bool "enable vbspbuflp1v"
		default n
	config SMP_CPU1_DISABLE
		 bool "not enalbe the cpu1 when using the SMP"
		default n
	config LPO_MP_A_FORCE_USE_EXT32K
		 bool "MP_A force use the external 32k"
		default n
	config ROSC_CALIB_SW
		 bool "enable calibrate rc32k by software"
		default n
	config ROSC_COMPENSATION
		 bool "enable rosc compensation for rtc tick"
		default n
	config LP_VOL
		hex "Set Low power voltage value"
		default 0x6
		help
			Set Low power voltage default value 0.6v(0.45+0.025*6)
	config DIGLDO_LOW_VOLTAGE_ENABLE
		 bool "enable dig ldo low voltage "
		default y
endmenu
```

## t5_os/bk_idk/middleware/driver/reset_reason/Kconfig
```kconfig
menu "RESET_REASON"
	config RESET_REASON
		bool "Enable reset reason"
		default y

	config RESET_REASON_TEST
		bool "Enable reset reason test"
		default y
endmenu
```

## t5_os/bk_idk/middleware/driver/saradc/Kconfig
```kconfig
menu "SARADC"
	config SARADC
		bool "Enable saradc"
		default y

	config SARADC_NEED_FLUSH
		bool "SARADC whether need flush data"
		default y

	config SARADC_RANGE_DIVIDE
		bool "Enable saradc measure range divide"
		default n

	config SARADC_PM_CB_SUPPORT
		bool "saradc pm support"
		depends on SARADC
		default n

	config ADC_BUF_SIZE
		int "config adc receive buffer size"
		default 32

endmenu	
```

## t5_os/bk_idk/middleware/driver/trng/Kconfig
```kconfig
menu "TRNG"
	config TRNG_SUPPORT
		bool "Support hardware TRNG"
		default y
        config TRNG_PM_CB_SUPPORT
                bool "trng pm support"
                default n
endmenu
```
