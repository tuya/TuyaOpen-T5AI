## t5_os/bk_idk/components/app/Kconfig
```kconfig
menu "App"

	config DEMO_TEST
		bool "Enable Demo Test"
		default n

	#TODO does UPGRADE here means OTA?
	config FTPD_UPGRADE
		bool "Enable Ftpd Upgrade"
		default n

	config OTA_HTTP
		depends on WIFI_ENABLE
		bool "Enable Ota Http"
		default y if NO_HOSTED
		default n if !NO_HOSTED

	#TODO what's the relationship between HTTP and TFTP OTA, exculsive?
	config OTA_TFTP
		bool "Enable Ota Tftp"
		default n

	config NTP_SYNC_RTC
		depends on AON_RTC
		bool "Enable Ntp Sync Rtc"
		default n

	config SECURITY_OTA
		bool "Enable Seucirty Ota API"
		default n

endmenu
```

## t5_os/bk_idk/components/at_server/Kconfig
```kconfig
menu "At_server"

config AT
	bool "Enable At"
	default y
		
	config WIFI_AT_ENABLE
		depends on AT 
		bool "Enable WIFI AT CMDS"
		default y

	config MISC_AT_ENABLE
		depends on AT 
		bool "Enable SYSTEM AT CMDS"
		default y

	config BT_AT_ENABLE
		depends on AT 
		bool "Enable BLUETOOTH AT CMDS"
		default y

	config BLE_AT_ENABLE
		depends on AT 
		bool "Enable BLE AT CMDS"
		default y
	
	config DEFAULT_AT_PORT
		depends on AT 
		int "defualt at_Port"
		default 1
		
	config AT_MAX_PORT_CNT
		depends on AT 
		int "defualt AT_CLIENT nums"
		default 1		
		
	config AT_DATA_MODE
		depends on AT 
		bool "enable AT Socket"
		default n			
endmenu
 
```

## t5_os/bk_idk/components/bk_bluetooth/Kconfig
```kconfig
menu "Bk_ble"
	depends on BLUETOOTH

	config BT
		bool "Enable Bt"
		default n

	config BLE
		bool "Enable Ble"
		default y

	choice BLE_STACK
		prompt "Select Ble Version"
		depends on (BLE || BT)
		default BLE_5_X

		config BLE_5_X
			bool "BLE 5.X"
		config BLE_4_2
			bool "BLE 4.2"
		config BTDM_5_2
			bool "BTDM 5.2"
		config BTDM_5_2_MINDTREE
			bool "BTDM 5.2 Mindtree Host"
	endchoice

	config BTDM_CONTROLLER_ONLY
		bool "BTDM controller only"
		default n

    config BLUETOOTH_LINK_MAX_COUNT
        int "bt/ble/dual link max count, when dual means bt link max count and ble max count. When set 9999, means set as big as possible."
        default 9999
        range 1 9999

    config BLUETOOTH_BLE_DISCOVER_AUTO
        bool "auto ble discover. Only used when single ble host"
        default y

    config BLUETOOTH_CALIBRATION_ENABLE
        bool "whether to enable bluetooth calibration"
        default y
endmenu
```

## t5_os/bk_idk/components/bk_system/Kconfig
```kconfig
#TODO may need to remove this component!
menu "BK_system"

	menu "Mac Config"
		choice BASE_MAC_SRC
			prompt "Select Base Mac Source"
			default NEW_MAC_POLICY

			config BASE_MAC_FROM_EFUSE
				bool "BASE_MAC_FROM_EFUSE"
			config BASE_MAC_FROM_RF_OTP_FLASH
				bool "BASE_MAC_FROM_RF_OTP_FLASH"
			config NEW_MAC_POLICY
				bool "NEW_MAC_POLICY"
			config BASE_MAC_FROM_OTP1
				bool "BASE_MAC_FROM_OTP1"
		endchoice

		config RANDOM_MAC_ADDR
	        bool "Enable Random Mac Addr"
	        default n

		config BK_MAC_ADDR_CHECK
			bool "Enable Beken Mac Addr Check"
			default n

		config CUS_MAC_MASK
			hex "Set Customize Mac Address Mask"
			default 0
	endmenu

	menu "Print Config"
		choice SYSTEM_PRINT_DEVICE
			prompt "System print device"
			default SYS_PRINT_DEV_UART

			config SYS_PRINT_DEV_UART
				bool "System print by uart"

			config SYS_PRINT_DEV_MAILBOX
				bool "System print by mailbox"

			config SYS_PRINT_DEV_NULL
				bool "Close system print"
		endchoice

		config FWD_CMD_TO_CPUx
			depends on MAILBOX
			bool "Forward cpu1/cpu2 cmd by mailbox"
			default y

		config SMP_SYNC_PRINTF
			bool "smp sync printf"
			default n

		config UART_PRINT_BAUD_RATE
			depends on SYS_PRINT_DEV_UART
			int "uart print baud rate"
			default "115200"
	endmenu
endmenu
```

## t5_os/bk_idk/components/compress/Kconfig
```kconfig
menu "decompress"
	config LZMA1900
		bool "Enable LZMA1900"
		default n

	config LZMA2301
		bool "Enable LZMA2301"
		default n
endmenu
```

## t5_os/bk_idk/components/lwip_intf_v2_1/Kconfig
```kconfig
#TODO add depens for CONFIG_HOST (bk7231u)
menu "Lwip_intf_v2_1"

	config IPV6
		bool "Enable IPV6"
		default n

	config WIFI_FAST_DHCP
		bool "Enable Wifi Fast Dhcp"
		default n
		help
			Enable Fast DHCP(use previous IP)

	config STA_USE_STATIC_IP
		bool "Enable sta use static ip"
		default n

	config MQTT_ACK_NOW
		bool "Enable Mqtt Ack Now"
		default y
		help
			Enable ACK_NOW if MQTT is open

	config LWIP_TCP_SACK_OUT
		bool "Enable TCP SACK"
		default n

	config LWIP
		depends on WIFI_ENABLE || ETH
		bool "Enable LWIP"
		default y

	config IP_FORWARD
		bool "Enable IP FORWARD"
		default n

	config IP_FORWARD_ALLOW_TX_ON_RX_NETIF
		bool "enable IP forward on rx interface"
		default n

	config IP_NAPT
		bool "Enable IP NAPT"
		default n

	config WIFI_REAPETER
		bool "Enable WIFI_REAPETER"
		default n

	config BRIDGE
                bool "Enable LWIP BRIDGE"
                default n

	menu "Modify Lwip Config"
		depends on LWIP

		config DHCP
			depends on WIFI_ENABLE
			bool "Enable DHCP"
			default y

		config DHCP_ONGOING_OPTIM
			bool "Enable DHCP_ONGOING_OPTIM"
			default n

		config AUTOIP
			bool "Enable AUTOIP"
			default n

		config MDNS
			bool "Enable MDNS"
			default n

		config TASK_LWIP_PRIO
			depends on WIFI_ENABLE
			int "Set Task Lwip Prio"
			range 1 10
			default 4
			help
				Priority of LwIP task

		config MIDEA
			bool "Enable MIDEA"
			default n

		config LWIP_MEM_TRX_DYNAMIC_EN
			bool "enable lwip mem trx dynamic"
			default y

		config LWIP_MEM_LIBC_MALLOC
			bool "use system libc malloc"
			default n

		config LWIP_MEMP_MEM_MALLOC
			bool "memp_alloc() use mem_malloc/mem_free instead of the lwip pool allocator"
			default y

		config LWIP_MEMP_STATS
			bool "memp statistics"
			default y

		config LWIP_MEM_STATS
			bool "mem statistics"
			default y

		config LWIP_DEBUG_LOG
			bool "Enable LWIP Debug Log"
			default n
			help
				open lwip debug log

		config ICMP_ERR_RATELIMIT
			bool "Enable ICMP rate limit"
			default n

		config ICMP_ERR_RATE_THRESHOLD
			int "ICMP rate limit threshold"
			default 10

		config ARP_TABLE_SIZE
			int "ARP table size"
			default 10

		#TODO optimize it
		choice LWIP_MEM
			prompt "Select Lwip Mem Policy"
			default LWIP_MEM_DEFAULT

			config LWIP_MEM_DEFAULT
				bool "LWIP_MEM_DEFAULT"
				help
					Default Memory Policy
			config LWIP_MEM_REDUCE
				depends on WIFI_ENABLE
				bool "LWIP_MEM_REDUCE"
				help
					Reduced Memory Policy
		endchoice
	endmenu

	menu "Memory Config"
	config LWIP_UDP_RECVMBOX_SIZE
		int "Default UDP receive mail box size"
		range 8 1024
		default 24
		help
		Set UDP receive mail box size. The recommended value is 24.

		UDP receive mail box is a per socket mail box, when the application receives packets
		from UDP socket, LWIP core firstly posts the packets to UDP receive mail box and the
		application then fetches the packets from mail box. It means LWIP can caches maximum
		UDP_RECCVMBOX_SIZE packets for each UDP socket, so the maximum possible cached UDP 
		packets for all UDP sockets is UDP_RECCVMBOX_SIZE multiples the maximum UDP socket 
		number. In other words, the bigger UDP_RECVMBOX_SIZE means more memory.On the other 
		hand, if the receiv mail box is too small, the mail box may be full. If the mail box
		is full, the LWIP drops the packets.So generally we need to make sure the UDP 
		receive mail box is big enough to avoid packet drop between LWIP core and application.

	config LWIP_MEM_SIZE
		int "Default size of the LWIP heap memory"
		range 1 102400
		default 51200
		help
			Set the size of the heap memory. The recommended value is 51200 .

	config LWIP_MEM_MAX_RX_SIZE
		int "Default size of the max memory rx used"
		range 1 102400
		default 38400
		help
			Set the size of the max memory rx used. The recommended value is 
			38400 ((LWIP_MEM_SIZE*3)/4).

	config LWIP_MEM_MAX_TX_SIZE
		int "Default the size of the max memory tx used"
		range 1 102400
		default 42666
		help
			Set the size of the max memory tx used. The recommended value is 
			42666 ((LWIP_MEM_SIZE*5)/6).
			If the application will send a lot of data 
			that needs to be copied, this should be set high.

	config LWIP_TCP_MSS
		int "Maximum Segment Size (MSS)"
		default 1460
		range 536 1460
		help
			Set maximum segment size for TCP transmission.

			Can be set lower to save RAM, the default value 1460(ipv4)/1440(ipv6) will
			give best throughput.
			IPv4 TCP_MSS Range: 576 <= TCP_MSS <= 1460
			IPv6 TCP_MSS Range: 1220<= TCP_mSS <= 1440

	config LWIP_TCP_SND_BUF
		int "Default send buffer size"
		default 29200 # 20 * default MSS
		range 2440 65535
		help
			Set default send buffer size for new TCP sockets.

			Per-socket send buffer size can be changed at runtime
			with lwip_setsockopt(s, TCP_SNDBUF, ...).

			This value must be at least 2x the MSS size, and the default
			is 4x the default MSS size.

			Setting a smaller default SNDBUF size can save some RAM, but
			will decrease performance.

	config LWIP_TCP_WND
		int "Default receive window size"
		default 29200 # 20 * default MSS
		range 2440 65535
		help
			Set default TCP receive window size for new TCP sockets.

			Per-socket receive window size can be changed at runtime
			with lwip_setsockopt(s, TCP_WINDOW, ...).

			Setting a smaller default receive window size can save some RAM,
			but will significantly decrease performance.

	config LWIP_MEMP_NUM_NETBUF
		int "Default number of struct netbufs"
		default 32
		range 1 1024
		help
			Set the number of struct netbufs.
			(only needed if you use the sequential API, like api_lib.c)
			This number corresponds to the maximum number of active sockets at any
			given point in time. This number must be sum of max.

	config LWIP_PBUF_POOL_SIZE
		int "Default number of buffers in the pbuf pool"
		default 10
		range 1 400
		help
			Set the size of each pbuf in the pbuf pool. The default is
			designed to accomodate single full size TCP frame in one pbuf, 
			including TCP_MSS, IP header, and link header.

	config LWIP_TCP_SND_QUEUELEN
		int "Default TCP sender buffer space (pbufs)"
		default 40
		range 1 200
		help
			Set TCP sender buffer space (pbufs).
			This must be at least as much as (2 * TCP_SND_BUF/TCP_MSS) for 
			things to work.

	config LWIP_MEMP_NUM_TCP_SEG
		int "Default simultaneously queued TCP segments"
		default 80
		range 1 500
		help
			Set the number of simultaneously queued TCP segments. 
			(requires the LWIP_TCP option)
			as much as (2 * LWIP_TCP_SND_QUEUELEN) for things to work.
	endmenu #Memory Config
endmenu
```

## t5_os/bk_idk/components/ota/Kconfig
```kconfig
menu "Ota"
	config HTTP_AB_PARTITION
		bool "Enable Http AB Partition"
		default n
		help
			enable http update ab partition
	config OTA_UPDATE_DEFAULT_PARTITION
		bool "Enable Ota Update Default Partition"
		default n
		help
			enable ota update default partition
	config OTA_UPDATE_B_PARTITION
		bool "Enable Ota Update B Partition"
		default n
		help
			enable ota update b partition
	config OTA_EVADE_METHOD
		bool "Enable Ota evade method"
		default n
		help
			enable ota evade method
	config OTA_HTTPS
		bool "Enable Https ota"
		default n
		help
			enable https ota
	config OTA_HASH_FUNCTION
		bool "Enable ota hash function"
		default n
		help
			enable ota hash function
	config OTA_DEBUG_LOG_OPEN
		bool "Enable ota debug log open"
		default n
		help
			enable ota debug log open
	config OTA_POSITION_INDEPENDENT_AB
		bool "Enable ota position independent update"
		default n
		help
			enable ota position independent update

	config OTA_TEST
		bool "Enable ota test"
		default y

	config SECURITY_OTA
		bool "Enable Seucirty Ota API"
		default n

	config VALIDATE_BEFORE_REBOOT
		bool "mcuboot validate before reboot"
		default n

	config OTA_UPDATE_PUBKEY
		bool "use public key in flash"
		default n

	config OTA_CONFIRM_UPDATE
		bool "confirm update after ota download"
		default n
endmenu
```

## t5_os/bk_idk/components/psa_mbedtls/Kconfig
```kconfig
menu "PSA Mbedtls"
	config PSA_MBEDTLS
		bool "Enable mbedtls v3.5.2"
		default n

	menu "PSA Mbedtls Options"
		depends on PSA_MBEDTLS

		config PSA_MBEDTLS_TEST
			bool "Enable psa mbedtls test"
			default n
	
		config PSA_CUSTOMIZATION_TZ_L
			bool "Enable adapt customization interface"
			default n
	
		config PSA_CUSTOMIZATION_TEST
			bool "Enable psa customization test"
			default n
	
		config MBEDTLS_SSL_IN_CONTENT_LEN
			int "Config MBEDTLS_SSL_IN_CONTENT_LEN"
			default 4096
	
		config MBEDTLS_SSL_OUT_CONTENT_LEN
			int "Config MBEDTLS_SSL_OUT_CONTENT_LEN"
			default 4096
	
		config TE200_ENTROPY
			bool "Enable TE200 entropy"
			default n
	
	        config TRUSTENGINE_TEST
	                bool "Enable security engine cli"
	                default y
	
	        config TRUSTENGINE
	                bool "Enable hardware crypto engine"
	                default n
	
	        config SW_CRYPTO
	                bool "Enable software crypto"
	                default n
	endmenu
endmenu
```

## t5_os/bk_idk/components/tfm_mbedtls/Kconfig
```kconfig
menu "TFM Mbedtls"
	config MBEDTLS_ACCELERATOR
		bool "Enable mbedtls accelerator"
		default n

	config TE200_TEST
		bool "Enable TE200 test"
		default n
endmenu
```

## t5_os/bk_idk/middleware/driver/camera/Kconfig
```kconfig
menu "CAMERA"
	config DVP_CAMERA
		bool "Enable Camera"
		depends on JPEGENC_HW
		depends on I2C
		depends on GENERAL_DMA
		default n
		help
			Enable camera interface

	config DVP_CAMERA_I2C_ID
		int "Set Camera I2c Id"
		range 0 2
		default 0
		help
			The value should be changed if need to change i2c id

	config CAMERA_POWER_GPIO_CTRL
		bool "Enable camera power gpio ctrl"
		default n

	config CAMERA_CTRL_POWER_GPIO_ID
		int "the gpio id control camera power"
		default 9

	config ENCODE_BUF_DYNAMIC
		bool "Enable encode buffer dynamic malloc"
		default n

	config UVC_CHECK_BULK_JPEG_HEADER
		depends on USB_UVC
		bool "Check JPEG (ff d8) header in bulk payload"
		default y

	config UVC_MAX_PACKET_CNT
		int "one packet include eight packet, use to save uvc raw data"
		range 0 64
		default 16

	config JPEG_FRAME_SIZE
		int "config a jpeg frame size unit(byte), default 150k"
		default 153600

	config H264_FRAME_SIZE
		int "config a h264 NALU size unit(byte), default 64k"
		default 65536

	config JPEG_FRAME_CHECK_LENGTH
		int "check jpeg frame effective length, check from frame end, until find 0xffd9"
		default 1024

endmenu
```

## t5_os/bk_idk/middleware/driver/general_dma/Kconfig
```kconfig
menu "GENERAL_DMA"
	config GENERAL_DMA
		bool "Enable General DMA"
		default y

	choice GDMA_HW_VERSION
		prompt "GDMA HW version in ASIC"
		default GDMA_HW_V1PX

		config GDMA_HW_V2PX
			bool "GDMA HW version v2px in ASIC"
			default n

		config GDMA_HW_V1PX
			bool "GDMA HW version v1px in ASIC"
			default y
	endchoice

	config DMA_LOGIC_CHAN_CNT
		prompt "Current CPU-CORE software system uses how many dma-logic-channels. \
		        Total of all CPU-COREs dma logic chan count should be not bigger then total dma hardware supportted channels"
		depends on GDMA_HW_V2PX
		int "4"
		default 4 if GDMA_HW_V2PX

	config DMA_LOGIC_CHAN_ID_MIN
		prompt "Current CPU-CORE software system min dma-logic-channel-id. \
		        Be care overlap the other CPU-CORE software system's dma-logic-channel-id. \
		        The value should be set like this: \
		        CPU0 is from 0; \
		        CPU1 is from CPU0_DMA_LOGIC_CHAN_CNT \
		        CPU2 is from CPU0_DMA_LOGIC_CHAN_CNT + CPU1_DMA_LOGIC_CHAN_CNT"
		depends on GDMA_HW_V2PX
		int "0"
		default 0 if GDMA_HW_V2PX
endmenu
```
