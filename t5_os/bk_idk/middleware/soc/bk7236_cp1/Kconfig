## t5_os/bk_idk/middleware/soc/bk7236_cp1/Kconfig
```kconfig
menu "bk7236"

	config ITCM_SIZE
		hex "Total ITCM size"
		default 0x4000

	config DTCM_SIZE
		hex "Total DTCM size"
		default 0x4000

	config CPU0_SPE_RAM_SIZE
		hex "CPU0 RAM size for SPE"
		default 0x50000

	config CPU0_NSPE_RAM_SIZE
		hex "CPU0 RAM size for NSPE"
		default 0x40000

	config CPU1_APP_RAM_SIZE
		hex "CPU1 app RAM size"
		default 0x30000

	config ANA_REG_WRITE_POLL_REG_B
		bool "Write analog register polls sys reg0xb"
		default y

	config PM_HAL_DEBUG
		bool "Enable PM hal debug"
		default n

	config PM_HAL_CTRL
		bool "Enable PM hal debug"
		default n
        config TZ
                bool "Supported TrustZone"
                default y

        config SPE
                int "Enable SPE"
                default 0
endmenu
```

## t5_os/bk_idk/middleware/soc/bk7239_cp1/Kconfig
```kconfig
menu "bk7239"

	config ITCM_SIZE
		hex "Total ITCM size"
		default 0x4000

	config DTCM_SIZE
		hex "Total DTCM size"
		default 0x4000

	config CPU0_SPE_RAM_SIZE
		hex "CPU0 RAM size for SPE"
		default 0x50000

	config CPU0_NSPE_RAM_SIZE
		hex "CPU0 RAM size for NSPE"
		default 0x40000

	config CPU1_APP_RAM_SIZE
		hex "CPU1 app RAM size"
		default 0x30000

	config ANA_REG_WRITE_POLL_REG_B
		bool "Write analog register polls sys reg0xb"
		default y

	config PM_HAL_DEBUG
		bool "Enable PM hal debug"
		default n

	config PM_HAL_CTRL
		bool "Enable PM hal debug"
		default n
endmenu
```

## t5_os/bk_idk/middleware/soc/bk7258/Kconfig
```kconfig
menu "bk7258"

	config ITCM_SIZE
		hex "Total ITCM size"
		default 0x4000

	config DTCM_SIZE
		hex "Total DTCM size"
		default 0x4000

	config CPU0_SPE_RAM_SIZE
		hex "CPU0 RAM size for SPE"
		default 0x50000

	config CPU0_NSPE_RAM_SIZE
		hex "CPU0 RAM size for NSPE"
		default 0x40000

	config CPU1_APP_RAM_SIZE
		hex "CPU1 app RAM size"
		default 0x40000

	config CPU2_APP_RAM_SIZE
		hex "CPU2 app RAM size"
		default 0x10000

	config ANA_REG_WRITE_POLL_REG_B
		bool "Write analog register polls sys reg0xb"
		default y

	config PM_HAL_DEBUG
		bool "Enable PM hal debug"
		default n

	config PM_HAL_CTRL
		bool "Enable PM hal debug"
		default n

        config TZ
                bool "Supported TrustZone"
                default y

        config SPE
                int "Enable SPE"
                default 0

	config RX_OPTIMIZE
		bool "Optimize rx current"
		default n

	config BT_REUSE_MEDIA_MEMORY
		bool "BT reuse media memory at beging of cpu1"
		default n

	config BT_REUSE_MEDIA_MEM_SIZE
		depends on BT_REUSE_MEDIA_MEMORY
		hex "BT reuse media memory size"
		default 0x28000
		
endmenu
```

## t5_os/bk_idk/middleware/soc/bk7258/bk7258.defconfig
```kconfig
CONFIG_SOC_ARCH="cm33"
CONFIG_SOC_BK7236XX=y
CONFIG_SOC_BK7236_V5=y
CONFIG_SOC_BK7258=y
CONFIG_SOC_STR="bk7258"
CONFIG_ARCH_CM33=y
CONFIG_CMSIS=y
# CONFIG_DEFAULT_CMSIS_START is not set
CONFIG_FPGA=y
CONFIG_SPE=1
CONFIG_TOOLCHAIN_PATH="/opt/gcc-arm-none-eabi-10.3-2021.10/bin"
CONFIG_CPU_CNT=3
# CONFIG_ASSERT_HALT is not set
# CONFIG_ASSERT_REBOOT is not set
# CONFIG_JTAG is not set
CONFIG_FREERTOS_TRACE=n
CONFIG_LWIP_V2_1=y
CONFIG_NO_HOSTED=y
# CONFIG_SEMI_HOSTED is not set
# CONFIG_FULLY_HOSTED is not set
# CONFIG_WIFI_SENSOR is not set
# CONFIG_DEMO_TEST is not set
# CONFIG_FTPD_UPGRADE is not set
CONFIG_OTA_HTTP=y
# CONFIG_OTA_TFTP is not set
CONFIG_AT=y
CONFIG_AT_SUPPORT_MULTICORE=n
CONFIG_DEFAULT_AT_PORT=0
CONFIG_WIFI_AT_ENABLE=y
CONFIG_MISC_AT_ENABLE=y
CONFIG_BT_AT_ENABLE=y
CONFIG_BLE_AT_ENABLE=y
CONFIG_NETIF_AT_ENABLE=y
CONFIG_AT_CMD=n

CONFIG_AUDIO=y
CONFIG_AUDIO_ADC=y
CONFIG_AUDIO_DAC=y
CONFIG_AUDIO_DMIC=n
CONFIG_AUDIO_DTMF=n
CONFIG_CALI=y
CONFIG_MANUAL_CALI=y
CONFIG_TPC_PA_MAP=y
CONFIG_ATE=y
CONFIG_ATE_TEST=n
CONFIG_BLE=y
CONFIG_BLE_5_X=n
CONFIG_BTDM_5_2=y
CONFIG_BTDM_5_T_MINDTREE=n
CONFIG_BT=n
# CONFIG_BLE_4_2 is not set
CONFIG_CLI=y
CONFIG_BKREG=y
# CONFIG_TCP_SERVER_TEST is not set
# CONFIG_AIRKISS_TEST is not set
# CONFIG_WIFI_RAW_TX_TEST is not set
# CONFIG_I2C1_TEST is not set
# CONFIG_I2C2_TEST is not set
# CONFIG_UART_TEST is not set
# CONFIG_PERI_TEST is not set
# CONFIG_RF_OTA_TEST is not set
CONFIG_SHELL_ASYNCLOG=y
CONFIG_DYM_LOG_MEM_MAX=0x2000
CONFIG_RF_POLICY_BLE_REQ=y
# CONFIG_RF_POLICY_WIFI_REQ is not set
# CONFIG_RF_POLICY_CO_REQ is not set
CONFIG_CHECK_MISMATCH=y
CONFIG_MCU_PS=y
# CONFIG_DEEP_PS is not set
CONFIG_TICK_CALI=y
CONFIG_STA_PS=y
CONFIG_FREERTOS=y
# CONFIG_LITEOS_M is not set
CONFIG_FREERTOS_V9=n
CONFIG_FREERTOS_V10=y
# CONFIG_MALLOC_STATIS is not set
CONFIG_MEM_DEBUG=y
CONFIG_CM_BACKTRACE=y
CONFIG_APP_MAIN_TASK_PRIO=4
CONFIG_APP_MAIN_TASK_STACK_SIZE=4096
CONFIG_FLASH_SIZE_4M=y
CONFIG_FLASH_QUAD_ENABLE=y
CONFIG_FLASH_MB=y
# CONFIG_BASE_MAC_FROM_EFUSE is not set
# CONFIG_BASE_MAC_FROM_RF_OTP_FLASH is not set
CONFIG_NEW_MAC_POLICY=y
CONFIG_BK_MAC_ADDR_CHECK=y
CONFIG_MBEDTLS=y
CONFIG_FULL_MBEDTLS=n
CONFIG_PSA_MBEDTLS=n
CONFIG_TRUSTENGINE=n



#
# USB configuration
#
CONFIG_USB=n
# end of USB configuration

CONFIG_WIFI_IP_AX_NEXT=y
CONFIG_WIFI6_CODE_STACK=y
CONFIG_WIFI6=y
CONFIG_WIFI4=y
CONFIG_MSDU_RESV_HEAD_LENGTH=96
CONFIG_MSDU_RESV_TAIL_LENGTH=16
CONFIG_TASK_RECONNECT_PRIO=4
CONFIG_WIFI_MAC_VERSION="V22"
CONFIG_WIFI_MDM_VERSION="v32"
CONFIG_WIFI_PLF_VERSION="v32"
CONFIG_MM_PS_SET_LISTEN_INTERVAL_VALUE=30
CONFIG_MOBILE_CONNECT_SAP_STATISTICS=y
# CONFIG_AP_MONITOR_COEXIST is not set
CONFIG_WIFI_FAST_CONNECT=y
# CONFIG_BSSID_CONNECT is not set
# CONFIG_WFA_CERT is not set
# CONFIG_LESS_MEMERY_IN_RWNX is not set
# CONFIG_AP_PROBEREQ_CB is not set
# CONFIG_MM_PS_BASED_ON_LISTEN_INTERVAL is not set
CONFIG_BK_SUPPLICANT_OPTIMIZE_CONNECTION=y
CONFIG_WIFI_OCV=y
CONFIG_MINIMIZE_SCAN_RESULT_IE=y
# CONFIG_WIFI_OWE is not set
CONFIG_DEAUTH_BEFORE_CONNECT=y
CONFIG_WIFI6_IP_DEBUG=y
CONFIG_BLE_PS=y
# CONFIG_BLE_HOST_NONE is not set
CONFIG_BLE_HOST_RW=y
# CONFIG_BLE_HOST_ZEPHYR is not set
CONFIG_BLE_MESH_NONE=y
# CONFIG_BLE_MESH_RW is not set
CONFIG_BLE_ADV_NUM=1
CONFIG_BLE_SCAN_NUM=1
CONFIG_BLE_INIT_NUM=1
CONFIG_BLE_CONN_NUM=1
CONFIG_AON_RTC=y
CONFIG_AON_RTC_64BIT=y
CONFIG_AON_RTC_MANY_USERS=y
CONFIG_AON_RTC_DEBUG=n
CONFIG_AON_RTC_TEST=y
CONFIG_AON_RTC_KEEP_TIME_SUPPORT=y
CONFIG_SYSTEM_CTRL=y
CONFIG_HAL_DEBUG_SYS=y
CONFIG_AON_PMU=y
CONFIG_INT_WDT=y
CONFIG_INT_WDT_PERIOD_MS=8000
CONFIG_TASK_WDT=y
CONFIG_TASK_WDT_PERIOD_MS=16000
CONFIG_NMI_WDT_EN=y
CONFIG_AON_WDT=n
CONFIG_INT_AON_WDT=n
CONFIG_INT_AON_WDT_PERIOD_MS=8000
CONFIG_I2C=y
CONFIG_FM_I2C=n
CONFIG_I2C_PM_CB_SUPPORT=n
CONFIG_UART1=y
CONFIG_UART2=y
CONFIG_UART3=y
CONFIG_UART_ATE_PORT=0
CONFIG_UART_PRINT_PORT=0
CONFIG_PRINTF_BUF_SIZE=256
# CONFIG_BACKGROUND_PRINT is not set
CONFIG_KFIFO_SIZE=128
CONFIG_UART_ERR_INTERRUPT=y
# CONFIG_UART_STATIS is not set
CONFIG_UART_PM_CB_SUPPORT=y
CONFIG_TRNG_SUPPORT=y
CONFIG_TRNG_PM_CB_SUPPORT=y
CONFIG_RANDOM_MAC_ADDR=y
CONFIG_SDCARD=y
CONFIG_SDCARD_DEFAULT_CLOCK_FREQ=11
CONFIG_SDCARD_BUSWIDTH_4LINE=n
CONFIG_SDCARD_POWER_GPIO_CTRL=y
CONFIG_FATFS=y
CONFIG_FATFS_SDCARD=y
CONFIG_SDCARD_DEBUG_SUPPORT=n
CONFIG_MAC_PHY_BYPASS=y
CONFIG_SDIO=y
CONFIG_SDIO_V1P0=n
CONFIG_SDIO_V2P0=y
CONFIG_SDIO_HOST=y
CONFIG_SDIO_SLAVE=n
CONFIG_SDIO_CHANNEL_EN=n
CONFIG_SDIO_BIDIRECT_CHANNEL_EN=n
CONFIG_SDIO_GDMA_EN=y
CONFIG_GPIO_NOTIFY_TRANSACTION_EN=n
CONFIG_SDIO_4LINES_EN=n
CONFIG_SDIO_TEST_EN=n
CONFIG_SDIO_DEBUG_EN=n
CONFIG_SDIO_HOST_DEFAULT_CLOCK_FREQ=7
CONFIG_SDIO_HOST_CLR_WRITE_INT=y
CONFIG_SDIO_PM_CB_SUPPORT=n
CONFIG_SPI=y
CONFIG_SPI_DMA=y
CONFIG_SPI_STATIS=y
CONFIG_SPI_SUPPORT_TX_FIFO_WR_READY=y
CONFIG_SPI_PM_CB_SUPPORT=n
CONFIG_SPI_MST_FLASH=y
CONFIG_QSPI=y
CONFIG_QSPI_FLASH_GD=y

CONFIG_MEDIA=y
CONFIG_MEDIA_APP=y
CONFIG_WIFI_TRANSFER=y
CONFIG_USB_TRANSFER=y
CONFIG_IMAGE_STORAGE=y

# CONFIG_CALENDAR is not set
# CONFIG_SYS_REDUCE_NORMAL_POWER is not set
# CONFIG_XTAL_FREQ_40M is not set
CONFIG_XTAL_FREQ_26M=y
CONFIG_XTAL_FREQ=26000000
CONFIG_DCO_FREQ=120000000
CONFIG_SYSTEM_CLOCK=y
# CONFIG_PTA is not set
CONFIG_I2S=y
CONFIG_PWM=n
CONFIG_PWM_V1PX=y
CONFIG_PWM_PM_CB_SUPPORT=y
# CONFIG_SUPPORT_IRDA is not set
CONFIG_MAILBOX=y
CONFIG_MAILBOX_V2_0=y
CONFIG_EASY_FLASH=y
CONFIG_EASY_FLASH_V4=y

CONFIG_DHCP=y

#
# LwIP
#
CONFIG_LWIP=y
CONFIG_TASK_LWIP_PRIO=4
# CONFIG_LWIP_MEM_DEFAULT is not set
CONFIG_LWIP_MEM_REDUCE=y
# Enable LWIP mem/memp malloc from HEAP
CONFIG_LWIP_MEM_LIBC_MALLOC=y
CONFIG_LWIP_MEMP_MEM_MALLOC=y
# end of LwIP

# CONFIG_MP3PLAYER is not set
# CONFIG_PCM_RESAMPLER is not set
# CONFIG_AP_IDLE is not set
# CONFIG_FAKE_RTC_PS is not set
# CONFIG_PM_MODEM_PWD is not set
# CONFIG_PM_STANDALONE is not set
CONFIG_PM_V2=y
CONFIG_TX_EVM_TEST=y
CONFIG_RX_SENSE_TEST=y
CONFIG_WIFI_KMSG_TASK_PRIO=3
CONFIG_WIFI_KMSG_TASK_STACK_SIZE=4096
CONFIG_WIFI_CORE_TASK_PRIO=2
CONFIG_WIFI_CORE_TASK_STACK_SIZE=2048
CONFIG_RWNX_QOS_MSDU=y
CONFIG_RWNX_SW_TXQ=y
CONFIG_RWNX_FAST_CONNECT=y
CONFIG_TEMP_DETECT=y
CONFIG_VOLT_DETECT=y

CONFIG_SARADC_NEED_FLUSH=n
CONFIG_SARADC_RANGE_DIVIDE=n
CONFIG_SARADC_PM_CB_SUPPORT=y
# CONFIG_UART_DEBUG is not set
# CONFIG_UDISK_MP3 is not set
# CONFIG_WFA_CA is not set
CONFIG_TASK_WPAS_PRIO=5
CONFIG_WPA3=y
CONFIG_PMF=y
CONFIG_WPA_CTRL_IFACE=y
CONFIG_AP_HT_IE=y
CONFIG_AP_VHT=y
CONFIG_AP_HE=y
# CONFIG_WPA_TWT_TEST is not set
CONFIG_STA_AUTO_RECONNECT=y
# CONFIG_WPA_LOG is not set
CONFIG_LCD_TEST=n
CONFIG_DMA2D_TEST=n
#CONFIG_DOORBELL=y
CONFIG_FFT=n
CONFIG_CKMN=y
CONFIG_TFM=n
CONFIG_SDMADC=y
CONFIG_SDMADC_TEST=y
CONFIG_HW_ROTATE_PFC=n
CONFIG_HW_ROTT_TEST=n
CONFIG_FREERTOS_USE_TICKLESS_IDLE=2
CONFIG_SYSTICK_32K=y
CONFIG_TIMER_US=y
CONFIG_TIMER_SUPPORT_ID_BITS=7
CONFIG_TIMER_PM_CB_SUPPORT=y
CONFIG_UART_LOW_VOLTAGE_SUPPORT=y
CONFIG_GPIO_WAKEUP_SUPPORT=y
CONFIG_GPIO_DYNAMIC_WAKEUP_SUPPORT=y
CONFIG_GPIO_DYNAMIC_WAKEUP_SOURCE_MAX_CNT=4
CONFIG_GPIO_WAKEUP_DEBUG=n
CONFIG_DEBUG_FIRMWARE=n
CONFIG_GPIO_DEFAULT_SET_SUPPORT=y
CONFIG_OTP=y
CONFIG_OTP_V1=y
CONFIG_PHY_RFCALI_TO_OTP=n
CONFIG_PHY_LOG_ENABLE=n
CONFIG_PUF_TEST=y
CONFIG_WIFI_ADAPTER=y
CONFIG_NET_PARAM_INTF=y
CONFIG_BLUETOOTH=y
CONFIG_TOUCH_TEST=y
CONFIG_SPE_TEST=n
CONFIG_INTERRUPT_TEST=y
CONFIG_AON_PMU_TEST=y
CONFIG_CACHE_ENABLE=n
CONFIG_MPU=y
CONFIG_TOUCH=y

#
# PSRAM
#
CONFIG_PSRAM=y
CONFIG_PSRAM_TEST=y
CONFIG_PSRAM_AS_SYS_MEMORY=y
CONFIG_USE_PSRAM_HEAP_AT_SRAM_OOM=n
CONFIG_PSRAM_WRITE_THROUGH=y
CONFIG_PSRAM_CALIBRATE=y
CONFIG_PSRAM_AUTO_DETECT=y
# end of PSRAM

CONFIG_LDO_SELF_LOW_POWER_MODE_ENA=y
CONFIG_VND_CAL=y
CONFIG_ANA_REG_WRITE_POLL_REG_B=n
CONFIG_OBJDUMP=n
#
# PWR_CLK
#
CONFIG_EXTERN_32K=n
CONFIG_LPO_SRC_26M32K=n
CONFIG_BUCK_ENABLE=y
CONFIG_RX_OPTIMIZE=n
CONFIG_BAKP_POWER_DOMAIN_DISABLE=y
CONFIG_PSRAM_POWER_DOMAIN_LV_DISABLE=n
CONFIG_AHBP_POWER_DOMAIN_LV_DISABLE=n
CONFIG_CPU_DEFAULT_FREQ_60M=y
CONFIG_DCO_CLK_ENABLE=n
CONFIG_VBSPBUFLP1V_ENABLE=y
CONFIG_LV_FLASH_ENTER_LP_ENABLE=n
CONFIG_LPO_MP_A_FORCE_USE_EXT32K=y
CONFIG_ROSC_CALIB_SW=y
CONFIG_LP_VOL=0x6
CONFIG_DIGLDO_LOW_VOLTAGE_ENABLE=n
# end of PWR_CLK
CONFIG_LIN=n
CONFIG_LIN_DEVICE_MASTER=n
CONFIG_GENERAL_DMA=y
CONFIG_GDMA_HW_V2PX=y
CONFIG_DMA_LOGIC_CHAN_CNT=4
CONFIG_DMA_LOGIC_CHAN_ID_MIN=12
CONFIG_SYS_CPU1_OFFSET=0x21c0000
#
# bk7258
#
CONFIG_DTCM_SIZE=0x3FE0
# end of bk7258

CONFIG_PM_ENABLE=y
CONFIG_PM_SUPER_DEEP_SLEEP=y
CONFIG_RTC_ANA_WAKEUP_SUPPORT=y
CONFIG_GPIO_ANA_WAKEUP_SUPPORT=y
CONFIG_BAKP_POWER_DOMAIN_PM_CONTROL=y
CONFIG_GPIO_RETENTION_SUPPORT=y
```

## t5_os/components/bk_peripheral/src/lcd/rgb/Kconfig
```kconfig
menu "RGB LCD"

    # Modified by TUYA Start
    config LCD_ILI9488
		depends on LCD
		bool "Enable LCD_ILI9488 API"
		default n

    config LCD_GC9503_BOE
		depends on LCD
		bool "Enable LCD_GC9503_BOE API"
		default n

    config LCD_T50P181CQ
		depends on LCD
		bool "Enable LCD_T50P181CQ API"
		default n

    config LCD_TUYA_COMMON_RGB
		depends on LCD
		bool "Enable LCD_TUYA_COMMON_RGB API"
		default n
    # Modified by TUYA End

	config LCD_GC9503V
		depends on LCD
		bool "Enable LCD_GC9503V API"
		default n

	config LCD_H050IWV
		depends on LCD
		bool "Enable LCD_H050IWV API"
		default n

	config LCD_HX8282
		depends on LCD
		bool "Enable LCD_HX8282 API"
		default n

	config LCD_MD0430R
		depends on LCD
		bool "Enable LCD_MD0430R API"
		default n

	config LCD_MD0700R
		depends on LCD
		bool "Enable LCD_MD0700R API"
		default n

	config LCD_NT35512
		depends on LCD
		bool "Enable LCD_NT35512 API"
		default n

	config LCD_NT35510
		depends on LCD
		bool "Enable LCD_NT35510 API"
		default n

	config LCD_ST7282
		depends on LCD
		bool "Enable LCD_ST7282 API"
		default n

	config LCD_ST7701S_LY
		depends on LCD
		bool "Enable LCD_ST7701S_LY API"
		default n

	config LCD_ST7701S
		depends on LCD
		bool "Enable LCD_ST7701S API"
		default n
   
	config LCD_ST7701SN
		depends on LCD
		bool "Enable LCD_ST7701SN API"
		default n

	config LCD_AML01
		depends on LCD
		bool "Enable LCD_AML01 API"
		default n

endmenu
```

## t5_os/components/bk_thirdparty/cs2p2p/Kconfig
```kconfig
#TODO remove all kconfigs which are defined in armino libs

menu "cs2p2p"

	config CS2_P2P_SERVER
		bool "Enable CS2 P2P server"
		default n
		help
			Enable CS2 P2P server lib

	config CS2_P2P_CLIENT
		bool "Enable CS2 P2P client"
		default n
		help
			Enable CS2 P2P client lib

	config CS2_P2P_TEST
		bool "Enable CS2 P2P Test"
		default n
		help
			Enable CS2 P2P lib test

	config CS2_TX_BUFFER_THD
		int "Default threshold of the CS2 TX buffer"
		range 1 262144
		default 5120
		help
			Set the threshold of the CS2 TX buffer. The recommended value is 5120 (1024*5).

	config CS2_MALLOC_USE_PSRAM
		bool "cs2_malloc() malloc memory from PSRAM"
		default n
		help
			Enable this config to malloc memory by CS2 from PSRAM

	config CS2_DEBUG_LIB
		bool "Use CS2 debug lib"
		default n
		help
			Use debug CS2 lib to analyze CS2 issues
endmenu
```
