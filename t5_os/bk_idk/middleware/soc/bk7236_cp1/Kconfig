## t5_os/components/lvgl/Kconfig
```kconfig
menu "Lvgl"
	config LVGL
		depends on LCD
		bool "Enable Lvgl"
		default n

	choice LVGL_VERSION
		depends on LVGL
		prompt "Select LVGL Version"
		default LVGL_V8

		config LVGL_V8
			bool "LVGL V8"
		config LVGL_V9
			bool "LVGL V9"
	endchoice

	config LV_COLOR_DEPTH
		depends on LVGL
		int "Set Lv Color Depth"
		default 16
		help
			1 - 1 byte per pixel
			8 - RGB332
			16 - RGB565
			24 - RGB888(Just for V9)
			32 - ARGB888

	config LV_DRAW_THREAD_STACK_SIZE
		depends on LVGL_V9
		int "Set the stack size of the drawing threads"
		default 8192

	config LVGL_SRAM_MAPPING
		bool "Enable Lvgl Sram Mapping"
		default n

	config LV_COLOR_SCREEN_TRANSP
		bool "Enable Lv Color Screen Transp"
		default n
		help
			Enable features to draw on transparent background

	config LV_FONT_MONTSERRAT_8
		bool "Enable Lv Font Montserrat 8"
		default n

	config LV_FONT_MONTSERRAT_16
		bool "Enable Lv Font Montserrat 16"
		default n

	config LV_FONT_MONTSERRAT_12
		bool "Enable Lv Font Montserrat 12"
		default n

	config LV_FONT_MONTSERRAT_18
		bool "Enable Lv Font Montserrat 18"
		default n

	config LV_FONT_MONTSERRAT_20
		bool "Enable Lv Font Montserrat 20"
		default n

	config LV_FONT_MONTSERRAT_22
		bool "Enable Lv Font Montserrat 22"
		default n

	config LV_FONT_MONTSERRAT_24
		bool "Enable Lv Font Montserrat 24"
		default n

	config LV_FONT_MONTSERRAT_26
		bool "Enable Lv Font Montserrat 26"
		default n

	config LV_FONT_MONTSERRAT_28
		bool "Enable Lv Font Montserrat 28"
		default n

	config LV_FONT_MONTSERRAT_30
		bool "Enable Lv Font Montserrat 30"
		default n

	config LV_FONT_MONTSERRAT_32
		bool "Enable Lv Font Montserrat 32"
		default n

	config LV_FONT_MONTSERRAT_34
		bool "Enable Lv Font Montserrat 34"
		default n

	config LV_FONT_MONTSERRAT_36
		bool "Enable Lv Font Montserrat 36"
		default n

	config LV_FONT_MONTSERRAT_38
		bool "Enable Lv Font Montserrat 38"
		default n

	config LV_FONT_MONTSERRAT_40
		bool "Enable Lv Font Montserrat 40"
		default n

	config LV_FONT_MONTSERRAT_42
		bool "Enable Lv Font Montserrat 42"
		default n

	config LV_FONT_MONTSERRAT_44
		bool "Enable Lv Font Montserrat 44"
		default n

	config LV_FONT_MONTSERRAT_46
		bool "Enable Lv Font Montserrat 46"
		default n

	config LV_FONT_MONTSERRAT_48
		bool "Enable Lv Font Montserrat 48"
		default n

	config LV_USE_PERF_MONITOR
		bool "Enable Lv Use Perf Monitor"
		default n
		help
			Show CPU usage and FPS count

	config LVGL_USE_PSRAM
		bool "Enable Lvgl Use Psram"
		default n
		help
			Enable PSRAM draw buffer

	config LVGL_USE_DIRECT_MODE
		depends on LVGL_V8
		bool "Enable Lvgl Use Direct Mode"
		default y
		help
			Enable use direct mode in LVGL use psram draw buffer

	config LV_ATTRIBUTE_FAST_MEM
		bool "Enable Lv Attribute Fast Mem"
		default n

	config LVGL_TASK_PRIORITY
		depends on LVGL
		int "Set lvgl task priority"
		default 4

	config LVGL_TASK_SLEEP_TIME_CUSTOMIZE
		depends on LVGL
		bool "Enable lvgl task sleep time custimize"
		default n

	config LVGL_TASK_SLEEP_TIME
		depends on LVGL_TASK_SLEEP_TIME_CUSTOMIZE
		int "Set lvgl task sleep time"
		default 10

	config LV_COLOR_16_SWAP
		depends on LVGL_V8
		bool "Enable Swap the 2 bytes of RGB565 color"
		default n

	config LV_ATTRIBUTE_FAST_MEM_L2
		bool "Enable Lv Attribute Fast Mem L2"
		default n

	config LV_CODE_LOAD_PSRAM
		bool "Enable Lv Code load psram"
		default n
endmenu
```

## t5_os/projects/lvgl/widgets_v9/main/Kconfig.projbuild
```kconfig
menu "LVGL widgets_v9 Configuration"

    config LV_USE_DEMO_WIDGETS
        bool "LVGL Widgets"
        default n
endmenu
```

## t5_os/projects/tuya_app/main/Kconfig.projbuild
```kconfig
menu "TUYA_APP"

    config TUYA_APP_PARAM1
        bool "TUYA_APP_PARAM1"
        default n
    config TUYA_APP_PARAM2
        bool "TUYA_APP_PARAM2"
        default n
	config SUPPORTED_IMAGE_MAX_720P
		bool "Supported image max 720P"
        default n
endmenu
```

## tuyaos/tuyaos_adapter/Kconfig
```kconfig
menu "TUYA_SDK"
    config TUYA_OS_ADAPTER
        bool "Add tuya os adapter"
        default n

    config TUYA_APP_SOURCES
        bool "Add tuya app"
        default n

    config TUYA_COMPONENTS
        bool "Add tuya component"
        default n

    config APP_CLI_STATION
        depends on TUYA_OS_ADAPTER
        bool "Add tuya app cli station component"
        default n

    config APP_DEMO_QUICKSTAT
        depends on TUYA_OS_ADAPTER
        bool "Add tuya app demo quickstart component"
        default n

    config CPU_INDEX
        int "cpu index"
        default 255

    config TUYA_LOG_OPTIMIZATION
        bool "enable log OPTIMIZATION"
        default y
        help
        this config should be enable, or log maybe lost

    config TUYA_LOGIC_MODIFY
        bool "tuya modify"
        default y

    config TUYA_PAGE_TILEVIEW
        bool "Config Tuya GUI Gesture"
        default n

    config TUYA_TEST_CLI
        bool "tuya test"
        default n

    config VND_CAL_VERSION
        int "cal file version"
        range 1 3
        default 1

    config ENABLE_TUYA_LVGL_TEST_DEMO
        int "enable tuya lvgl test demo"
        range 0 1
        default 0

    config TUYA_ENABLE_QSPI_FLASH
        bool "enable tuya qspi flash"
        default n

    config TUYA_QSPI_FLASH_TYPE
        string "qspi flash type"
        default "gd25q127c"

endmenu
```
